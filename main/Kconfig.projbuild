## main/Kconfig.projbuild
```kconfig
menu "UCSC Thread-ASCON Experiment Workload"
    config OPENTHREAD_AUTO_START
        bool 'Enable the automatic start mode.'
        default False
        help
            If enabled, the Openthread Device will create or connect to thread network with pre-configured
            network parameters automatically. Otherwise, user need to configure Thread via CLI command manually.

    config EXPERIMENT
      int 'The network performance experiment to run.'
      default 0
      help
        Set '0' to run no experiment (primarily used for debugging purposes).
        Set '1' to run the Throughput Confirmable experiment.
        Set '2' to run the Throughput Non-Confirmable experiment.
        Set '3' to run the Packet Loss Confirmable experiment.
        Set '4' to run the Packet Loss Non-Confirmable experiment.
        Set '5' to run the Delay experiment.

    config TX_POWER
      int 'Set the 802.15.4 TX power used by OpenThread.'
      range -128 127
      default 20
      help
          Set the 802.15.4 transmission power (in dBm) for OpenThread.
          The recommended TX power values are 20 dBm, 9 dBm, 0 dBm, and -25 dBm.

    config COAP_SERVER_PORT
      int 'The port number for the CoAP server.'
      default 5684
      help
          Sets the port used by CoAP server side.

    config SERVER_IP_ADDRESS
      string 'IP address of the CoAP server.'
      help
          Sets the IPv6 address of the server to establish a CoAP connection with.

    config DEBUG
      int 'Toggles debugging print statements.'
      range 0 1
      default 0
      help
          Set to "0" to turn off debugging print statements.
          Set to "1" to turn on debugging print statements.
endmenu
```
